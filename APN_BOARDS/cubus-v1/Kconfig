## APN_BOARDS/cubus-v1/Kconfig
```kconfig
#
# For a description of the syntax of this configuration file,
# see the file kconfig-language.txt in the NuttX tools repository.
#

if CONFIG_ARCH_BOARD_CUSTOM	

config ARCH_BOARD_CUSTOM_DIR_RELPATH
	bool "option defines the presence of relaitve DIR path"
	default y
	---help---
		Activating the presence of relative path to custom board config

config ARCH_BOARD_CUSTOM_DIR
	string "relative custom board directory"
	default "../APN_BOARDS/cubus-v1"
	---help---
		Relative board directroy for custom board configurations

config ARCH_BOARD_CUSTOM_NAME
	string "name of board"
	default "cubus"
	---help---

config ARCH_BOARD_CUSTOM_HIGHPRI
	bool "High priority interrupt test"
	default n
endif
```

## custom_apps/ekf_app/Kconfig
```kconfig
#
# For a description of the syntax of this configuration file,
# see the file kconfig-language.txt in the NuttX tools repository.
#

config CUSTOM_APPS_EKF_APP
	tristate "EKF APP"
	default n
	---help---
		Enable the \"EKF APP \". The EKF app deals with receiving of data

if CUSTOM_APPS_EKF_APP

config CUSTOM_APPS_EKF_APP_PROGNAME
	string "Program name"
	default "ekf"
	---help---
		This is the name of the program that will be used when the NSH ELF
		program is installed.


config CUSTOM_APPS_EKF_APP_PRIORITY
	int "EKF app task priority"
	default 100

config CUSTOM_APPS_EKF_APP_STACKSIZE
	int "EKF_APP stack size"
	default DEFAULT_TASK_STACKSIZE

endif
```

## custom_apps/uart_app/Kconfig
```kconfig
#
# For a description of the syntax of this configuration file,
# see the file kconfig-language.txt in the NuttX tools repository.
#

config CUSTOM_APPS_UART_APP
	tristate "UART APP"
	default n
	---help---
		Enable the \"UART APP \". The UART app deals with receiving of data

if CUSTOM_APPS_UART_APP

config CUSTOM_APPS_UART_APP_PROGNAME
	string "Program name"
	default "uart"
	---help---
		This is the name of the program that will be used when the NSH ELF
		program is installed.


config CUSTOM_APPS_UART_APP_PRIORITY
	int "UART app task priority"
	default 100

config CUSTOM_APPS_UART_APP_STACKSIZE
	int "UART_APP stack size"
	default DEFAULT_TASK_STACKSIZE

endif
```
